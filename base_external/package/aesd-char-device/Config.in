## base_external/package/aesd-char-device/Config.in
```kconfig
config BR2_PACKAGE_AESD_CHAR_DEVICE
	bool "aesd-char-device"
	help
	  Includes the aesdchar device driver and server application for AESD assignments.
```
